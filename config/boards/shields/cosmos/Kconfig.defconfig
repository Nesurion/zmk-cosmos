## config/boards/shields/cosmos/Kconfig.defconfig
```kconfig
# Copyright (c) 2022 The ZMK Contributors
# SPDX-License-Identifier: MIT

if SHIELD_COSMOS_LEFT

config ZMK_KEYBOARD_NAME
    default "cosmos"
    
config ZMK_SPLIT_ROLE_CENTRAL
    default y

endif

if SHIELD_COSMOS_LEFT || SHIELD_COSMOS_RIGHT

config ZMK_SPLIT
    default y

endif
```
